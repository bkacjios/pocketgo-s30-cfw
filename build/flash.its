## build/flash.its
```
/*
 * SPI flash FIT (build.sh flash): kernel, DTB, initramfs and the boot
 * script. build.sh copies it into s30-build: /incbin/ paths are relative to it.
 */
/dts-v1/;

/ {
	description = "PocketGo S30 flash boot";
	#address-cells = <1>;

	images {
		kernel {
			data = /incbin/("boot/zImage");
			type = "kernel";
			arch = "arm";
			os = "linux";
			compression = "none";
			load = <0x42000000>;
			entry = <0x42000000>;
			hash { algo = "crc32"; };
		};
		fdt {
			data = /incbin/("boot/sun8i-a33-pocketgo-s30.dtb");
			type = "flat_dt";
			arch = "arm";
			compression = "none";
			hash { algo = "crc32"; };
		};
		ramdisk {
			data = /incbin/("initramfs.cpio.gz");
			type = "ramdisk";
			arch = "arm";
			os = "linux";
			compression = "none";
			hash { algo = "crc32"; };
		};
		script {
			data = /incbin/("flash.cmd");
			type = "script";
			compression = "none";
			hash { algo = "crc32"; };
		};
	};

	configurations {
		default = "s30";
		s30 {
			kernel = "kernel";
			fdt = "fdt";
			ramdisk = "ramdisk";
		};
	};
};
```

## linux/drivers/gpu/drm/panel/Kconfig.s30
```kconfig
config DRM_PANEL_ILITEK_ILI9488_DSI
	tristate "Ilitek ILI9488 MIPI-DSI panel"
	depends on OF
	depends on DRM_MIPI_DSI
	depends on BACKLIGHT_CLASS_DEVICE
	help
	  Say Y here to support the Ilitek ILI9488 320x480 MIPI-DSI panel
	  used in the PocketGo S30.
```

## linux/drivers/input/joystick/Kconfig.s30
```kconfig
config JOYSTICK_POCKETGO_S30
	tristate "PocketGo S30 gamepad"
	depends on I2C
	depends on GPIOLIB || COMPILE_TEST
	help
	  Say Y here for the PocketGo S30 handheld's analog stick (read via a
	  microcontroller on I2C) and gamepad buttons, reported as one input
	  device.
```
